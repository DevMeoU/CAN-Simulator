VERSION ""

NS_ :

BS_:

BU_: ABS Instrumentcluster ECM Gateway

BO_ 300 ABS_WheelSpeed: 8 ABS
 SG_ FrontWheelSpeed : 5|14@0+ (0.112,0) [0|255] "km/h"  ECM,Gateway
 SG_ RearLeftWheelSpeed : 21|14@0+ (0.112,0) [0|255] "km/h"  ECM,Gateway

BO_ 100 Engine_Control: 8 ECM
 SG_ RPM : 15|16@0+ (1,0) [0|65535] "rpm"  Gateway,Instrumentcluster,ABS

BO_ 98 Ignition_State: 8 Instrumentcluster
 SG_ Ignition_Status : 7|4@0+ (1,0) [0|0] ""  ABS,ECM,Gateway,Instrumentcluster

CM_ BU_ Gateway "Gateway is responsible for sending from CAN1 to CAN2";
